## core/kernel/kernel-for-hardware/linux-6.11.9/kernel/sched/Kconfig.rusty
```kconfig
config SCHED_RUSTY
    bool "Rusty CPU Scheduler"
    depends on SMP && FAIR_GROUP_SCHED
    default n
    help
      This option enables the Rusty CPU scheduler, a custom scheduler
      designed for AetherOS that provides improved real-time capabilities
      and better task prioritization.

      The Rusty scheduler includes features like:
      - Local and global priority management
      - Improved preemption control
      - Task migration statistics
      - RT bandwidth control
      - Load balancing optimizations

      If unsure, say N.

config SCHED_RUSTY_LOCAL_PRIO
    int "Rusty Local Priority Level"
    depends on SCHED_RUSTY
    range 1 99
    default 5
    help
      Sets the default local priority level for the Rusty scheduler.
      Lower values mean higher priority.

      The local priority affects how tasks are scheduled within a single CPU.
      A value of 5 provides a good balance between responsiveness and fairness.

config SCHED_RUSTY_GLOBAL_PRIO
    int "Rusty Global Priority Level"
    depends on SCHED_RUSTY
    range 1 99
    default 5
    help
      Sets the default global priority level for the Rusty scheduler.
      Lower values mean higher priority.

      The global priority affects how tasks are distributed across CPUs.
      A value of 5 provides a good balance between load distribution and
      cache locality.
```
